## sdkconfig.defaults
```kconfig
# CONFIG_SPIRAM=y
# CONFIG_SPIRAM_MODE_OCT=y
# CONFIG_SPIRAM_SPEED_80M=y

CONFIG_LV_USE_USER_DATA=y
CONFIG_LV_USE_CHART=y
# CONFIG_LV_USE_PERF_MONITOR is not set
CONFIG_LV_USE_DEMO_BENCHMARK=y
# CONFIG_LV_USE_PNG is not set
# CONFIG_LV_USE_SJPG is not set
CONFIG_LV_MEM_SIZE_KILOBYTES=64
CONFIG_BT_ENABLED=y
CONFIG_BT_GATTS_ENABLE=n
CONFIG_BT_GATTC_ENABLE=n
CONFIG_BT_BLE_SMP_ENABLE=n
CONFIG_BT_BLE_SMP_BOND_NVS_FLASH=n

CONFIG_ESPTOOLPY_FLASHSIZE_4MB=y
CONFIG_PARTITION_TABLE_CUSTOM=y
```
